## app/boards/arm/ebyte_e73/Kconfig.board
```kconfig
# EBYTE E73 board configuration

# Copyright (c) 2018 makerdiary.com.
# SPDX-License-Identifier: Apache-2.0

config BOARD_EBYTE_E73
	bool "EBYTE E73"
	depends on SOC_NRF52832_QFAA
```

## app/boards/arm/ebyte_e73/Kconfig.defconfig
```kconfig
# EBYTE E73 board configuration

# Copyright (c) 2018 makerdiary.com.
# SPDX-License-Identifier: Apache-2.0

if BOARD_EBYTE_E73

config BOARD
	default "ebyte_e73"

config BT_CTLR
	default BT

endif # BOARD_EBYTE_E73
```

## app/boards/arm/ebyte_e73/ebyte_e73_defconfig
```kconfig
# SPDX-License-Identifier: Apache-2.0

CONFIG_SOC_SERIES_NRF52X=y
CONFIG_SOC_NRF52832_QFAA=y
CONFIG_BOARD_EBYTE_E73=y

# Enable MPU
CONFIG_ARM_MPU=y

# enable GPIO
CONFIG_GPIO=y

# enable console
CONFIG_CONSOLE=y
CONFIG_USE_SEGGER_RTT=y
CONFIG_RTT_CONSOLE=y

# additional board options
CONFIG_GPIO_AS_PINRESET=y

CONFIG_OPENOCD_SUPPORT=y
```
